## meta-xt-control-domain/conf/layer.conf
```bitbake
# We have a conf and classes directory, add to BBPATH
BBPATH .= ":${LAYERDIR}"

# We have a packages directory, add to BBFILES
BBFILES += "${LAYERDIR}/recipes-*/*/*.bb \
            ${LAYERDIR}/recipes-*/*/*.bbappend"

BBFILE_COLLECTIONS += "xt-control-domain"
BBFILE_PATTERN:xt-control-domain := "^${LAYERDIR}/"
BBFILE_PRIORITY:xt-control-domain = "6"

LAYERSERIES_COMPAT:xt-control-domain = "kirkstone"
```

## meta-xt-dom0/conf/layer.conf
```bitbake
# We have a conf and classes directory, add to BBPATH
BBPATH .= ":${LAYERDIR}"

# We have a packages directory, add to BBFILES
BBFILES += "${LAYERDIR}/recipes-*/*/*.bb \
            ${LAYERDIR}/recipes-*/*/*.bbappend"

BBFILE_COLLECTIONS += "xt-dom0"
BBFILE_PATTERN:xt-dom0 := "^${LAYERDIR}/"
BBFILE_PRIORITY:xt-dom0 = "6"

LAYERSERIES_COMPAT:xt-dom0 = "kirkstone"
```

## meta-xt-domu/conf/layer.conf
```bitbake
# We have a conf and classes directory, add to BBPATH
BBPATH .= ":${LAYERDIR}"

# We have a packages directory, add to BBFILES
BBFILES += "${LAYERDIR}/recipes-*/*/*.bb \
            ${LAYERDIR}/recipes-*/*/*.bbappend"

BBFILE_COLLECTIONS += "xt-domu"
BBFILE_PATTERN:xt-domu := "^${LAYERDIR}/"
BBFILE_PRIORITY:xt-domu = "6"

LAYERSERIES_COMPAT:xt-domu = "kirkstone"
```

## meta-xt-domx/conf/layer.conf
```bitbake
# We have a conf and classes directory, add to BBPATH
BBPATH .= ":${LAYERDIR}"

# We have a packages directory, add to BBFILES
BBFILES += "${LAYERDIR}/recipes-*/*/*.bb \
            ${LAYERDIR}/recipes-*/*/*.bbappend"

BBFILE_COLLECTIONS += "xt-domx"
BBFILE_PATTERN:xt-domx := "^${LAYERDIR}/"
BBFILE_PRIORITY:xt-domx = "6"

LAYERSERIES_COMPAT:xt-domx = "kirkstone"
```
